## sdkconfig.defaults
```kconfig
# Shared sdkconfig.defaults -- chip-agnostic settings only.
# DO NOT add CONFIG_IDF_TARGET, flash size, flash mode, brownout level, or
# partition filename here -- those live in sdkconfig.defaults.esp32 / sdkconfig.defaults.esp32s3.

CONFIG_PARTITION_TABLE_CUSTOM=y
CONFIG_PARTITION_TABLE_OFFSET=0x10000

# Development workflow: plain idf.py flash. Re-enable encryption only for production hardening.
# CONFIG_SECURE_FLASH_ENC_ENABLED is not set
CONFIG_NVS_ENCRYPTION=y
CONFIG_NVS_SEC_KEY_PROTECT_USING_FLASH_ENC=y
# Note: NVS remains plaintext until Flash Encryption is fully enabled in Release mode.

# Bootloader defaults
CONFIG_BOOTLOADER_COMPILE_TIME_DATE=n
CONFIG_BOOTLOADER_LOG_LEVEL_ERROR=y

# Disable ESP-IDF auto TWDT init (we init it ourselves in app_main with 10s timeout + panic)
# CONFIG_ESP_TASK_WDT_INIT is not set
CONFIG_ESP_TASK_WDT_CHECK_IDLE_TASK_CPU0=y
CONFIG_ESP_TASK_WDT_CHECK_IDLE_TASK_CPU1=y

# HTTP server plus captive DNS need socket headroom during browser refreshes.
CONFIG_LWIP_MAX_SOCKETS=32
CONFIG_LWIP_MAX_ACTIVE_TCP=32

# Runtime stats: enables CPU load measurement via idle task counters.
CONFIG_FREERTOS_GENERATE_RUN_TIME_STATS=y
CONFIG_FREERTOS_RUN_TIME_STATS_USING_ESP_TIMER=y

# Main task stack: default 3584 too tight. Increase for safety margin.
CONFIG_ESP_MAIN_TASK_STACK_SIZE=4608

# Event-loop (sys_evt) task stack: IDF default 2304 too tight for handlers that
# do NVS I/O + logging with large local buffers (wifi_manager IP_EVENT_STA_GOT_IP
# allocates wifi_ap_record_t + ssid[33] + pass[65] + NVS save frames). 4096 leaves
# ~1.5KB headroom and matches the headroom policy of ESP_MAIN_TASK_STACK_SIZE above.
CONFIG_ESP_SYSTEM_EVENT_TASK_STACK_SIZE=4096

# Stack overflow detection: panics on overflow instead of silently corrupting memory.
CONFIG_FREERTOS_CHECK_STACKOVERFLOW_CANARY=y

# Task list formatting for debugging
CONFIG_FREERTOS_USE_TRACE_FACILITY=y
CONFIG_FREERTOS_USE_STATS_FORMATTING_FUNCTIONS=y

# Coredump configuration for crash analysis
CONFIG_ESP_COREDUMP_ENABLE_TO_FLASH=y

# Brownout detector enabled (level set per-target in sdkconfig.defaults.<target>)
CONFIG_ESP_BROWNOUT_DET=y

# OTA: Rollback if firmware never calls esp_ota_mark_app_valid_cancel_rollback()
CONFIG_BOOTLOADER_APP_ROLLBACK_ENABLE=y

# Logging: Production profile
# Compile-time maximum = INFO (LOGD/LOGV stripped from binary)
# Default runtime level = WARN (noisy 3rd-party libs stay quiet)
CONFIG_LOG_DEFAULT_LEVEL_WARN=y
CONFIG_LOG_DEFAULT_LEVEL=2
CONFIG_LOG_MAXIMUM_EQUALS_DEFAULT=n
CONFIG_LOG_MAXIMUM_LEVEL_INFO=y
CONFIG_LOG_MAXIMUM_LEVEL=3
# ESP-IDF 6.0.1 keeps LOG_IN_IRAM enabled by default unless the
# SPI-flash auto-suspend path is enabled; do not claim to override it here.
```

## sdkconfig.defaults.esp32
```kconfig
# ESP32 classic (DevKit V1 30-pin) -- 4 MB Flash, DIO mode, 40 MHz
# Loaded automatically by ESP-IDF v5+ after sdkconfig.defaults when target=esp32.

CONFIG_IDF_TARGET="esp32"
CONFIG_PARTITION_TABLE_CUSTOM_FILENAME="partitions_esp32.csv"

CONFIG_ESPTOOLPY_FLASHSIZE_4MB=y
CONFIG_ESPTOOLPY_FLASHMODE_DIO=y
CONFIG_ESPTOOLPY_FLASHFREQ_40M=y

# Brownout level 2 (~2.53V) -- tolerant of relay-induced voltage sags
CONFIG_ESP_BROWNOUT_DET_LVL_SEL_2=y
```

## sdkconfig.defaults.esp32s3
```kconfig
# ESP32-S3-DevKitC-1 WROOM-1-N16R8 -- 16 MB Flash + 8 MB Octal PSRAM
# Loaded automatically by ESP-IDF v5+ after sdkconfig.defaults when target=esp32s3.

CONFIG_IDF_TARGET="esp32s3"
CONFIG_PARTITION_TABLE_CUSTOM_FILENAME="partitions_esp32s3.csv"

CONFIG_ESPTOOLPY_FLASHSIZE_16MB=y
CONFIG_ESPTOOLPY_FLASHMODE_QIO=y
CONFIG_ESPTOOLPY_FLASHFREQ_80M=y

# Octal PSRAM -- N16R8 has 8 MB OPI PSRAM on GPIO 33-37 (managed internally by IDF)
CONFIG_SPIRAM=y
CONFIG_SPIRAM_MODE_OCT=y
CONFIG_SPIRAM_SPEED_80M=y
CONFIG_SPIRAM_SIZE=-1
# CRITICAL: Do NOT enable SPIRAM_USE_MALLOC -- HTTP/FreeRTOS stacks must stay in internal RAM
CONFIG_SPIRAM_USE_MALLOC=n

# Use USB Serial/JTAG for monitor (S3 native USB -- connect the "USB" port, not "UART" port)
CONFIG_ESP_CONSOLE_USB_SERIAL_JTAG=y

# Brownout level 3 (~2.80V) -- S3 hardware default
CONFIG_ESP_BROWNOUT_DET_LVL_SEL_3=y
```
